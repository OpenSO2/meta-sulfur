## conf/layer.conf
```bitbake
BBPATH .= ":${LAYERDIR}"
BBFILES += "${LAYERDIR}/recipes-*/*/*.bb \
${LAYERDIR}/recipes-*/*/*.bbappend"
BBFILE_COLLECTIONS += "sulfur"
BBFILE_PATTERN_sulfur := "^${LAYERDIR}/"
BBFILE_PRIORITY_sulfur = "6"
```
